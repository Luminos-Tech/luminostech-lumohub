## Lumo/Lumo-Band/boards/arm/nrf52840_supermini/Kconfig.defconfig
```kconfig
# SPDX-License-Identifier: Apache-2.0

if BOARD_NRF52840_SUPERMINI

config HW_STACK_PROTECTION
    default ARCH_HAS_STACK_PROTECTION

endif
```

## Lumo/Lumo-Band/boards/arm/nrf52840_supermini/board.yml
```yaml
board:
  name: nrf52840_supermini
  full_name: nRF52840 Super Mini
  vendor: custom
  socs:
    - name: nrf52840
```

## vietfuture/lumo-vietfuture/Lumo-LuminosTech/main/Kconfig.projbuild
```kconfig
menu "LUMO device control"
    config LUMO_CONTROL_WS_URL
        string "Device command WebSocket URL (without query string)"
        default "wss://api.luminostech.tech/ws/lumo"
        help
            The firmware adds device_id to this URL. Use wss:// for public
            servers. A ws:// LAN address may be used for local development.
endmenu
```
